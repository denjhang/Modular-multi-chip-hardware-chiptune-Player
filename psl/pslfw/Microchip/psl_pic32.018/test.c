
#include <plib.h>
#include <stdio.h>
#include <string.h>
#include <math.h>
#include "types.h"
#include "hio.h"
#include "timer2.h"
#include "test.h"

#if __DEBUG
#if 0
//
volatile int g_nInt3Counter;

void __ISR(_EXTERNAL_3_VECTOR, ipl2) External3Handler(void)
{
	//clear the interrupt flag
	mINT3ClearIntFlag();
	//
	g_nInt3Counter++;
}

int PortTest(void)
{
	//
	struct tagPort {
		IoPortId portId;
		unsigned int inputs;
		char *string;
	} const port[] = {
		//
		{ IOPORT_C, BIT_2 , "mute" },
		//
		{ IOPORT_C, BIT_3 , "ic#"  },
		{ IOPORT_B, BIT_15, "a0"   },
		{ IOPORT_B, BIT_14, "a1"   },
		{ IOPORT_D, BIT_4 , "wr#"  },
		{ IOPORT_D, BIT_5 , "rd#"  },
		{ IOPORT_D, BIT_0 , "cs0#" },
		{ IOPORT_D, BIT_1 , "cs1#" },
		{ IOPORT_D, BIT_2 , "cs2#" },
		{ IOPORT_D, BIT_3 , "cs3#" },
		//
		{ IOPORT_G, BIT_9 , "a2"   },
		{ IOPORT_E, BIT_7 , "d7"   },
		{ IOPORT_E, BIT_6 , "d6"   },
		{ IOPORT_E, BIT_5 , "d5"   },
		{ IOPORT_E, BIT_4 , "d4"   },
		{ IOPORT_E, BIT_3 , "d3"   },
		{ IOPORT_E, BIT_2 , "d2"   },
		{ IOPORT_E, BIT_1 , "d1"   },
		{ IOPORT_E, BIT_0 , "d0"   },
		//
		{ IOPORT_A, BIT_10, "a6"   },
		{ IOPORT_G, BIT_7 , "a4"   },
		{ IOPORT_A, BIT_9 , "a7"   },
		{ IOPORT_G, BIT_6 , "a5"   },
		{ IOPORT_G, BIT_8 , "a3"   },
		//
		{ IOPORT_D, BIT_11, "a14"  },
		{ IOPORT_B, BIT_11, "a12"  },
		{ IOPORT_F, BIT_5 , "a8"   },
		{ IOPORT_F, BIT_4 , "a9"   },
		//
		{ IOPORT_D, BIT_10, "a15"  },
		{ IOPORT_B, BIT_10, "a13"  },
		{ IOPORT_B, BIT_12, "a11"  },
		{ IOPORT_B, BIT_13, "a10"  },
		{ IOPORT_D, BIT_7 , "d15"  },
		{ IOPORT_D, BIT_6 , "d14"  },
		{ IOPORT_D, BIT_13, "d13"  },
		{ IOPORT_D, BIT_12, "d12"  },
		{ IOPORT_F, BIT_0 , "d11"  },
		{ IOPORT_F, BIT_1 , "d10"  },
		{ IOPORT_G, BIT_1 , "d9"   },
		{ IOPORT_G, BIT_0 , "d8"   },
	};
	const int portcnt = sizeof(port)/sizeof(port[0]);
	printf(".portcnt=%d\n", portcnt);

	//
	int i, pbit, intcnt;
	struct PcKeySence key;

	//
	mPMPClose();
	//
	g_nInt3Counter = 0;
	ConfigINT3(EXT_INT_ENABLE | FALLING_EDGE_INT | EXT_INT_PRI_2);

	//
	pbit = 0;
	while(1){
		//
		DisableINT3;
		intcnt = g_nInt3Counter;
		g_nInt3Counter = 0;
		EnableINT3;
		if(intcnt)
			printf(".g_nInt3Counter=%d\n", intcnt);

		//
		PcKeySence(&key);
		if(key.key_code==0x00 || key.key_down==0){
			//入力なし、キー押上
			continue;
		}

		//共通
		int btoggle = 0, bpbit = 0;
		switch(key.key_code){
			case 0x1b:	//esc
				if(key.ctrl_state&0x10){
					//shift+esc
					printf(".PcSync\n");
					PcFlush();
					while(1){
						if(PcSync("psl", NULL))
							PcReset();
					}
				}
				break;

			case 0x54:	//t
				//
				printf(".wait_test\n");
				PcFlush();
				PcExit();
				//ic#
				mPORTCSetPinsDigitalOut(BIT_3);
				mPORTCClearBits(BIT_3);
				INTDisableInterrupts();
				while(1){
					mPORTCToggleBits(BIT_3);
					WaitUs(10);
				}
				break;

			case 0x20:	//space
				btoggle = 1;
				break;

			case 0x26:	//↑
				bpbit = +1;
				break;
			case 0x28:	//↓
				bpbit = -1;
				break;
		}

		//
		if(btoggle){
			//
			unsigned int lat;
			switch(port[pbit].portId){
				case IOPORT_A:
					mPORTASetPinsDigitalOut(port[pbit].inputs);
					mPORTAToggleBits(port[pbit].inputs);
					lat = mPORTAReadLatchBits(port[pbit].inputs);
					break;
				case IOPORT_B:
					mPORTBSetPinsDigitalOut(port[pbit].inputs);
					mPORTBToggleBits(port[pbit].inputs);
					lat = mPORTBReadLatchBits(port[pbit].inputs);
					break;
				case IOPORT_C:
					mPORTCSetPinsDigitalOut(port[pbit].inputs);
					mPORTCToggleBits(port[pbit].inputs);
					lat = mPORTCReadLatchBits(port[pbit].inputs);
					break;
				case IOPORT_D:
					mPORTDSetPinsDigitalOut(port[pbit].inputs);
					mPORTDToggleBits(port[pbit].inputs);
					lat = mPORTDReadLatchBits(port[pbit].inputs);
					break;
				case IOPORT_E:
					mPORTESetPinsDigitalOut(port[pbit].inputs);
					mPORTEToggleBits(port[pbit].inputs);
					lat = mPORTEReadLatchBits(port[pbit].inputs);
					break;
				case IOPORT_F:
					mPORTFSetPinsDigitalOut(port[pbit].inputs);
					mPORTFToggleBits(port[pbit].inputs);
					lat = mPORTFReadLatchBits(port[pbit].inputs);
					break;
				case IOPORT_G:
					mPORTGSetPinsDigitalOut(port[pbit].inputs);
					mPORTGToggleBits(port[pbit].inputs);
					lat = mPORTGReadLatchBits(port[pbit].inputs);
					break;
				default:
					printf(".%d=%d\n", pbit, port[pbit].portId);
					lat = 0;
					break;
			}
			printf(".toggle(%d,%s)=%d\n", pbit, port[pbit].string, lat?1:0);
		}
		//
		if(bpbit){
			bpbit += pbit;
			if(bpbit<0)
				bpbit = 0;
			else
			if(bpbit>(portcnt-1))
				bpbit = portcnt-1;
			if(bpbit!=pbit){
				pbit = bpbit;
				printf(".pbit=%d(%s)\n", pbit, port[pbit].string);
			}
		}
	}
}
#endif

#if 0
char *PcFgets(char *s, int n, s32 fh, s32 *fs)
{
	int i;
	s32 len;

#if 1
	//
	len = n-1;
	if(len>*fs)
		len = *fs;
	if(len<1){
		s[0] = '\0';
		return NULL;
	}
	PcRead(fh, s, len);
	//
	for(i=0; i<len; i++){
		if(s[i]=='\n'){
			s[i] = '\0';
			i++;
			break;
		}
	}
	PcLseek(fh, -(len-i), PC_SEEK_CUR);
	(*fs) -= i;
#else
	//
	char c;
	for(i=0; i<(n-1); i++){
		len = sizeof(c);
		if(*fs<len){
			if(i==0){
				s[i] = '\0';
				return NULL;
			}
			break;
		}
		PcRead(fh, &c, len);
		(*fs) -= len;
		if(c=='\n')
			break;
		s[i] = c;
	}
#endif

	s[i] = '\0';
	return s;
}

int str2dec(char *s, int base, int *v, char **q)
{
	int f;

	//
	f = 1;
	*v = 0;
	if(q!=NULL)
		*q = NULL;
	while(f){
		switch(*s){
			case '0':	case '1':	case '2':	case '3':	case '4':
			case '5':	case '6':	case '7':	case '8':	case '9':
				*v = (*v)*base+((*s)-'0');
				s++;
				break;
			case 'a':	case 'b':	case 'c':	case 'd':	case 'e':	case 'f':
			case 'A':	case 'B':	case 'C':	case 'D':	case 'E':	case 'F':
				if(base<10){
					*v = 0;
					return 1;
				}
				*v = (*v)*base+(((*s)|0x20)-'a')+0x0a;
				s++;
				break;
			case '\t':	case ' ':
				s++;
				break;
			case ',':
				f = 0;
				break;
			case '\0':	case '\n':	case '\r':
				f = 0;
				break;
			default:
				*v = 0;
				return 1;
		}
	}
	if(q!=NULL)
		*q = s;

	return 0;
}

int hex(char *s, unsigned char inst[8], int lim)
{
	int f, n, v;
	char *p;

	//
	f = 1;
	n = 0;
	while(f){
		switch(*s){
			case ',':
				n++;
				break;
			case '\t':	case ' ':
				break;
			case '\0':	case '\n':	case '\r':
				f = 0;
				break;
			default:
				if(n>=lim){
					f = 0;
					break;
				}
				//
				if(*s=='$'){
					if(str2dec(s+1, 16, &v, &p))
						return 1;
				} else
				if(*s=='0' && (*(s+1)|0x20)=='x'){
					if(str2dec(s+2, 16, &v, &p))
						return 1;
				} else
				if(*s>='0' && *s<='9'){
					if(str2dec(s, 10, &v, &p))
						return 1;
				} else
					return 1;
				//
				if(p==NULL || v<0x00 || v>0xff)
					return 1;
				inst[n] = v;
				s = p-1;
				break;
		}
		s++;
	}

	return 0;
}

int ini(char *path, unsigned char inst[16+3][8])
{
	s32 fh, fs;
	int f;
	char *p, *q, *r, buf[128];

	//
	printf(".ini(%s)\n", path);
	fh = PcOpen(path, PC_RDONLY|PC_BINARY);
	if(fh==-1){
		printf(".PcOpen(%s)\n", path);
		return 1;
	}
	fs = PcLseek(fh, 0, PC_SEEK_END);
	PcLseek(fh, 0, PC_SEEK_SET);

	//
	while(1){
		//
		if(PcFgets(buf, sizeof(buf), fh, &fs)==NULL)
			break;
		//
		f = 1;
		p = buf;
		q = r = NULL;
		while(f){
			switch(*p){
				case '=':
					if(q==NULL)
						f = 0;
					else
					if(r==NULL){
						*p = '\0';
						r = p+1;
					}
					break;
				case '#':
					*p = '\0';
					f = 0;
					break;
				case '\t':	case ' ':
					break;
				case '\0':	case '\n':	case '\r':
					*p = '\0';
					f = 0;
					break;
				case '[':	case ']':
					f = 0;
					break;
				default:
					if(q==NULL)
						q = p;
					break;
			}
			p++;
		}
		//
		if(q!=NULL && r!=NULL){
//			printf("%d,[%s],[%s]\n", fs, q, r);
			int instn;
			if(str2dec(q, 10, &instn, NULL)==0){
				if(instn>=0 && instn<=18){
//					printf("@%d,%d", sizeof(inst[instn]), sizeof(inst[instn])/sizeof(inst[instn][0]));
					if(hex(r, inst[instn], sizeof(inst[instn])/sizeof(inst[instn][0])))
						memset(inst[instn], 0x00, sizeof(inst[instn]));
				}
			}
		}
	}

	//
	PcClose(fh);
	return 0;
}

//
unsigned char insttbl[3][16+3][8];

int InitOpllInst(void)
{
	//
	memset(insttbl, 0x00, sizeof(insttbl));
	if(ini(".\\opll.ini", insttbl[0]))
		return 1;
	if(ini(".\\opllp.ini", insttbl[1]))
		return 1;
	if(ini(".\\vrc7.ini", insttbl[2]))
		return 1;
	
	return 0;
}
#endif

#if 0
//
const unsigned char adpcm[4096] = {
	0x08,0x08,0x08,0x08,0x08,0x08,0x08,0x80,0x80,0x80,0x80,0x80,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0x88,
	0x08,0x80,0x80,0x00,0x00,0x00,0x00,0x00,0x80,0x88,0x08,0x89,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0x00,
	0x80,0x89,0x88,0x98,0x99,0x88,0x88,0x08,0x01,0x01,0x01,0x01,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0x00,
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	0x13,0x54,0x35,0x33,0x33,0x22,0x18,0xab,0xfb,0xcb,0xda,0xaa,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0xbe,
};
#endif

#if 0
//sin 1k, 0db, fs=44.1k 441samples, big endian
const unsigned char pcm[441*2] = {
	0x12,0x2d,0x23,0xfb,0x35,0x0f,0x45,0x0f,0x53,0xaa,0x60,0x92,0x6b,0x85,0x74,0x4b, 0x7a,0xb5,0x7e,0xa2,0x7f,0xff,0x7e,0xc3,0x7a,0xf6,0x74,0xab,0x6c,0x03,0x61,0x2a,
	0x54,0x5a,0x45,0xd4,0x35,0xe3,0x24,0xdb,0x13,0x14,0x00,0xe9,0xee,0xba,0xdc,0xe5, 0xcb,0xc6,0xbb,0xb6,0xad,0x08,0xa0,0x08,0x94,0xfa,0x8c,0x18,0x85,0x8f,0x81,0x81,
	0x80,0x03,0x81,0x1d,0x84,0xca,0x8a,0xf5,0x93,0x80,0x9e,0x3e,0xaa,0xf7,0xb9,0x69, 0xc9,0x4a,0xda,0x46,0xec,0x06,0xfe,0x2d,0x10,0x5e,0x22,0x3a,0x33,0x65,0x43,0x85,
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	0x8b,0xb5,0x94,0x7b,0x9f,0x6e,0xac,0x56,0xba,0xf1,0xca,0xf1,0xdc,0x05,0xed,0xd3, 0x00,0x00
};
#endif

#if 0
//
const unsigned char ga20sin[] = {
	0x81,0x7e,0x81,0x86,0x88,0x85,0x8e,0x8d,0x8b,0x96,0x92,0x93,0x99,0x9b,0x98,0xa0,0x9e,0xa1,0xa3,0xa6,0xa3,0xab,0xaa,0xa8,0xb0,0xae,0xae,0xb2,0xb3,0xb2,0xb6,0xb6,
	0xb6,0xb9,0xb9,0xb8,0xbc,0xbb,0xba,0xbe,0xbd,0xbd,0xbc,0xbf,0xbe,0xbe,0xbd,0xbf,0xbe,0xbc,0xc0,0xba,0xbf,0xbb,0xbb,0xbc,0xb9,0xba,0xb7,0xba,0xb3,0xb8,0xb4,0xb2,
	0xb2,0xb1,0xae,0xae,0xad,0xaa,0xa7,0xaa,0xa4,0xa3,0xa5,0x9c,0xa1,0x9d,0x97,0x9b,0x97,0x91,0x95,0x90,0x8d,0x8b,0x8d,0x85,0x85,0x86,0x7f,0x7e,0x80,0x78,0x78,0x79,
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	0x77,
};

void WriteGa20(int cs, unsigned int addr, int reg, int data)
{
	//
	WriteIc(cs, addr+0x40+(reg&0x1f), data&0xff);
}

unsigned char ReadGa20(int cs, unsigned int addr, int reg)
{
	//
	return ReadIc(cs, addr+0x40+(reg&0x1f));
}

void WriteCpld(int cs, unsigned int addr, int reg, int data)
{
	//
	ChkStatusReg(cs, addr+0x60, 0x80, 0x00);
	WriteIc(cs, addr+0x60, reg&0xff);
	WriteIc(cs, addr+0x61, data&0xff);
}

unsigned char ReadCpld(int cs, unsigned int addr)
{
	//
	ChkStatusReg(cs, addr+0x60, 0x80, 0x00);
	return ReadIc(cs, addr+0x61);
}

int LoadGa20Wave(s32 fh, int cs, unsigned int addr, unsigned int start, unsigned int *end)
{
	const int whsize = 44;
	const int limit = ((1<<20)-1)/16;
	//
	unsigned char v, buf[128];

	//
	PcRead(fh, buf, whsize);
	if(memcmp(&buf[0x00], "RIFF", 4) || memcmp(&buf[0x08], "WAVEfmt ", 8) || memcmp(&buf[0x24], "data", 4) ||
		memcmp(&buf[0x14], "\x01\x00\x01\x00", 4) || memcmp(&buf[0x20], "\x01\x00\x08\x00", 4)){
		printf(".header\n");
		return 1;
	}
	int freq = buf[0x18+3];
	freq <<= 8;
	freq |= buf[0x18+2];
	freq <<= 8;
	freq |= buf[0x18+1];
	freq <<= 8;
	freq |= buf[0x18+0];
	int length = buf[0x28+3];
	length <<= 8;
	length |= buf[0x28+2];
	length <<= 8;
	length |= buf[0x28+1];
	length <<= 8;
	length |= buf[0x28+0];

	//
	s32 fs = PcLseek(fh, 0, PC_SEEK_END);
	fs -= whsize;
	if(length>fs)
		length = fs;
	length = (length-1)/16;
	if(length>limit)
		length = limit;
	if(length<1){
		printf(".length\n");
		return 1;
	}
	length = length*16+1;
	printf(".load(0x%05x,%d)=%dHz\n", start, length, freq);

	//
	WriteCpld(cs, 0, 0x01, 0x03);
	int i = start, j;
	if(i&0xff){
		WriteCpld(cs, 0, 0x03, (i>>16)&0x0f);
		WriteCpld(cs, 0, 0x02, (i>>8)&0xff);
		WriteCpld(cs, 0, 0x18, i&0xff);
	}
	PcLseek(fh, whsize, PC_SEEK_SET);
	*end = start+(length-1);
	while(length>0){
		//
		s32 rs = sizeof(buf);
		if(length<rs)
			rs = length;
		PcRead(fh, buf, rs);
		length -= rs;
		//
		for(j=0; j<rs; j++){
			if((i&0xff)==0x00){
				WriteCpld(cs, 0, 0x03, (i>>16)&0x0f);
				WriteCpld(cs, 0, 0x02, (i>>8)&0xff);
			}
			v = buf[j];
			WriteCpld(cs, 0, 0x08, (v==0x00)?0x01:v);
			i++;
		}
	}
	WriteCpld(cs, 0, 0x01, 0x01);
	return 0;
}

int Ga20Test(char *path)
{
	//
	const int cs = 3;
	const int start = 0xfff80;
	const int len = 0x101;
	const int lensin = sizeof(ga20sin)/sizeof(ga20sin[0]);
	const int wavestart = 0x00000;
	//
	int i, j, addr, ch, rate, gain, keyon, wtype, waveend;
	unsigned char data, data2, data3, r06, r07;
	struct PcKeySence key;

	//
	ch = 1;
	rate = 175;//251;
	gain = 63;
	r06 = 0x03;
	r07 = 0x00;
	keyon = 0;
	wtype = 1;
	waveend = 0x00000;
	while(1){
		//
		PcKeySence(&key);
		if(key.key_code==0x00 || key.key_down==0){
			//入力なし、キー押上
			continue;
		}

		//
		if(key.key_code==0x1b){	//esc
			if(key.ctrl_state&0x10){
				//shift+esc
				printf(".PcSync\n");
				PcFlush();
				while(1){
					if(PcSync("psl", NULL))
						PcReset();
				}
			}
			break;
		}

		//共通
		int binit = 0, bread = 0, bmem = 0, bch = 0, brate = 0, bgain = 0, br06 = -1, br07 = -1, btoggle = 0, bwtype = 0, bwinit = 0, bwplay = 0;
		switch(key.key_code){
			case 0x1b:	//esc
				if(key.ctrl_state&0x10){
					//shift+esc
					printf(".PcSync\n");
					PcFlush();
					while(1){
						if(PcSync("psl", NULL))
							PcReset();
					}
				}
				return 0;
			case 0x70:	//f1
				//※他アプリ起動用、使用できない
				break;

			case 0x31:	//1
				if(key.ctrl_state&0x10)
					br07 = 1;
				else
					br06 = 1;
				break;
			case 0x32:	//2
				if(key.ctrl_state&0x10)
					br07 = 2;
				else
					br06 = 2;
				break;
			case 0x33:	//3
				if(key.ctrl_state&0x10)
					br07 = 3;
				else
					br06 = 3;
				break;
			case 0x34:	//4
				if(key.ctrl_state&0x10)
					br07 = 4;
				else
					br06 = 4;
				break;
			case 0x35:	//5
				if(key.ctrl_state&0x10)
					br07 = 5;
				else
					br06 = 5;
				break;
			case 0x36:	//6
				if(key.ctrl_state&0x10)
					br07 = 6;
				else
					br06 = 6;
				break;
			case 0x37:	//7
				if(key.ctrl_state&0x10)
					br07 = 7;
				else
					br06 = 7;
				break;
			case 0x30:	//0
				if(key.ctrl_state&0x10)
					br07 = 0;
				else
					br06 = 0;
				break;

			case 0x09:	//tab
				bch = 1;
				break;
			case 0x52:	//r
				bread = 1;
				break;
			case 0x49:	//i
				bwinit = 1;
				break;
			case 0x50:	//p
				bwplay = 1;
				break;
			case 0xc0:	//@
				binit = 1;
				break;

			case 0xf0:	//capslock
				bwtype = 1;
				break;

			case 0x4d:	//m
				bmem = 1;
				break;

			case 0x20:	//space
				btoggle = 1;
				break;

			case 0x26:	//↑
				bgain = +1;
				break;
			case 0x25:	//←
				brate = -1;
				break;
			case 0x28:	//↓
				bgain = -1;
				break;
			case 0x27:	//→
				brate = +1;
				break;
		}

		//
		if(binit){
			printf(".init\n");
			ResetDevice();
			//
			WriteCpld(cs, 0, 0x0e, 0x80);
#if 1
			//
			WriteCpld(cs, 0, 0x01, 0x03);
			i = 0x00000;
			WriteCpld(cs, 0, 0x03, (i>>16)&0x0f);
			WriteCpld(cs, 0, 0x02, (i>>8)&0xff);
			for(; i<16; i++)
				WriteCpld(cs, 0, 0x08, (i==0)?0x80:0x00);
#endif
			WriteCpld(cs, 0, 0x01, 0x01);
			//
			keyon = 0;
		}
		//
		if(bread){
			printf(".read\n");
#if 0
			for(i=0; i<0x20; i++){
				printf("%02x", ReadGa20(cs, 0, i));
				if((i&7)==7)
					printf("\n");
			}
#endif
#if 0
			i = 1;
			printf("%d:", i);
			printf("%02x\n", ReadGa20(cs, 0, 0*8+i));
#endif
#if 1
			i = 7;
			printf("%d:", i);
			printf("%02x,", ReadGa20(cs, 0, 0*8+i));
			printf("%02x,", ReadGa20(cs, 0, 1*8+i));
			printf("%02x,", ReadGa20(cs, 0, 2*8+i));
			printf("%02x\n", ReadGa20(cs, 0, 3*8+i));
#endif
		}
		//
		if(bmem){
			//
			printf(".memory_test_start\n");
			WriteCpld(cs, 0, 0x01, 0x03);
			for(i=0x00000; i<=0xfffff; i++){
				if((i&0x1ffff)==0)
					printf("$%05x\n", i);
				if((i&0xff)==0x00){
					WriteCpld(cs, 0, 0x03, (i>>16)&0x0f);
					WriteCpld(cs, 0, 0x02, (i>>8)&0xff);
				}
				WriteCpld(cs, 0, 0x08, 0x00);
			}
			//
			data = 0x00;
			int skip = 0;
			for(i=0x00000; i<=0xfffff; i++){
				if((i&0x1ffff)==0){
					printf("%s$%05x,", i?"\n":"", i);
					PcFlush();
					skip = 0;
				}
				data += 3;
				if(data==0)
					data++;
				if(skip==0){
					if((i&0xff)==0x00){
						WriteCpld(cs, 0, 0x03, (i>>16)&0x0f);
						WriteCpld(cs, 0, 0x02, (i>>8)&0xff);
					}
					WriteCpld(cs, 0, 0x18, i&0xff);
					data3 = ReadCpld(cs, 0);
					WriteCpld(cs, 0, 0x08, data);
					WriteCpld(cs, 0, 0x18, i&0xff);
					data2 = ReadCpld(cs, 0);
					if(data!=data2 || data3!=0x00){
						printf("$%05x:$%02x<>$%02x,$00<>$%02x)", i, data, data2, data3);
						skip = 1;
					}
				}
			}
			printf("\n");
			printf(".memory_test_end\n");
			WriteCpld(cs, 0, 0x01, 0x01);
		}

		//
		if(bch){
			ch--;
			ch = (ch+1)%4;
			ch++;
			printf(".ch=%d\n", ch);
		}
		//
		if(brate){
			brate += rate;
			if(brate<0)
				brate = 0;
			else
			if(brate>0xff)
				brate = 0xff;	//0xffはアドレスが更新されない
			if(brate!=rate){
				rate = brate;
				int freq = (rate==0xff)?0:(((3579545/(256-rate))+2)/4);
				printf(".rate=%d, %d\n", rate, freq);
			}
			if(keyon){
				addr = (ch-1)*8;
				WriteGa20(cs, 0, addr+4, rate);
			}
		}
		//
		if(bgain){
			bgain += gain;
			if(bgain<0)
				bgain = 0;
			else
			if(bgain>0x3f)
				bgain = 0x3f;
			if(bgain!=gain){
				gain = bgain;
				double db = 20*log10(((gain==0)?1.0/74:gain)/63.0);	//※0のときの減衰量はたぶんクロストーク
				printf(".gain=%d, %5.2f\n", gain, db);
			}
			if(keyon){
				addr = (ch-1)*8;
				WriteGa20(cs, 0, addr+5, gain);
			}
		}
		//
		if(br06>=0){
			r06 ^= (1<<br06);
			printf(".$06bit=%02x\n", r06);
		}
		if(br07>=0){
			r07 ^= (1<<br07);
			printf(".$07bit=%02x\n", r07);
		}
		//
		if(bwtype){
			wtype ^= 1;
			printf(".wtype=%s\n", wtype?"sin":"test");
		}
		//
		if(btoggle){
			//
			keyon ^= 1;
			if(keyon){
				//
				WriteCpld(cs, 0, 0x01, 0x03);
				i = start;
				if(i&0xff){
					WriteCpld(cs, 0, 0x03, (i>>16)&0x0f);
					WriteCpld(cs, 0, 0x02, (i>>8)&0xff);
					WriteCpld(cs, 0, 0x18, i&0xff);
				}
				int length;
				if(wtype){
					//sin
					length = lensin;
					j = 0;
					for(; i<start+length; i++){
						if((i&0xff)==0x00){
							WriteCpld(cs, 0, 0x03, (i>>16)&0x0f);
							WriteCpld(cs, 0, 0x02, (i>>8)&0xff);
						}
						WriteCpld(cs, 0, 0x08, ga20sin[j]);
						j++;
					}
				} else {
					//test
					int v = 0x080;
					length = len;
					for(; i<start+length; i++){
						if((i&0xff)==0x00){
							WriteCpld(cs, 0, 0x03, (i>>16)&0x0f);
							WriteCpld(cs, 0, 0x02, (i>>8)&0xff);
						}
						switch(v){
							case 0x080:
								WriteCpld(cs, 0, 0x08, 0x80+0x70);
								break;
							case 0x100:
								WriteCpld(cs, 0, 0x08, 0x80+0x40);
								break;
							case 0x17e:
								WriteCpld(cs, 0, 0x08, 0xfe);
								break;
							case 0x17f:
								WriteCpld(cs, 0, 0x08, 0xff);
								break;
							case 0x180:
								//このサンプルは使われる
								WriteCpld(cs, 0, 0x08, 0x80-0x70);
//								WriteCpld(cs, 0, 0x08, 0x00);	//0x00は終端、dacには出力されない（前サンプルの値を維持）
								break;
							case 0x181:
								//このサンプルは使われない
								WriteCpld(cs, 0, 0x08, 0x00);
								break;
							default:
								WriteCpld(cs, 0, 0x08, v&0xff);
								break;
						}
						v = (v+1)&0x1ff;
					}
				}
				WriteCpld(cs, 0, 0x01, 0x01);
				//
				i = start;
				j = start+(length-1);
				printf(".keyon(ch%d, start=%05x, end=%05x, rate=%d, gain=%d, r06=%02x, r07=%02x)\n", ch, i, j&0xfffff, rate, gain, r06, r07);
				addr = (ch-1)*8;
				WriteGa20(cs, 0, addr+0, (i>>4)&0xff);
				WriteGa20(cs, 0, addr+1, (i>>12)&0xff);
				WriteGa20(cs, 0, addr+2, (j>>4)&0xff);
				WriteGa20(cs, 0, addr+3, (j>>12)&0xff);
				WriteGa20(cs, 0, addr+4, rate);
				WriteGa20(cs, 0, addr+5, gain);
				WriteGa20(cs, 0, addr+6, r06);
				WriteGa20(cs, 0, addr+7, r07);
			} else {
				printf(".keyoff\n");
				for(i=0; i<4; i++){
					addr = i*8;
					WriteGa20(cs, 0, addr+6, 0x00);
					WriteGa20(cs, 0, addr+5, 0x00);
				}
			}
		}
		//
		if(bwinit){
			printf(".winit_start\n");
			//
			s32 fh = PcOpen(path, PC_RDONLY|PC_BINARY);
			if(fh==-1)
				printf(".PcOpen(%s)\n", path);
			else {
				waveend = 0x00000;
				LoadGa20Wave(fh, cs, 0, wavestart, &waveend);
				PcClose(fh);
			}
			//
			printf(".winit_end\n");
		}
		if(bwplay){
			keyon ^= 1;
			if(keyon){
				//
				printf(".wplay(ch%d, r06=%02x, r07=%02x)\n", ch, r06, r07);
				addr = (ch-1)*8;
				WriteGa20(cs, 0, addr+0, (wavestart>>4)&0xff);
				WriteGa20(cs, 0, addr+1, (wavestart>>12)&0xff);
				WriteGa20(cs, 0, addr+2, (waveend>>4)&0xff);
				WriteGa20(cs, 0, addr+3, (waveend>>12)&0xff);
				WriteGa20(cs, 0, addr+4, rate);
				WriteGa20(cs, 0, addr+5, gain);
				WriteGa20(cs, 0, addr+6, r06);
				WriteGa20(cs, 0, addr+7, r07);
			} else {
				printf(".wstop\n");
				for(i=0; i<4; i++){
					addr = i*8;
					WriteGa20(cs, 0, addr+6, 0x00);
					WriteGa20(cs, 0, addr+5, 0x00);
				}
			}
		}
	}

	return 0;
}
#endif

#if 0
//
const unsigned char sccsin[] = {
	0x18,0x2e,0x43,0x56,0x65,0x70,0x77,0x79,0x77,0x70,0x65,0x56,0x43,0x2e,0x18,0x00,
	0xe8,0xd2,0xbd,0xaa,0x9b,0x90,0x89,0x87,0x89,0x90,0x9b,0xaa,0xbd,0xd2,0xe8,0x00,
};

void WriteScc(int cs, unsigned int addr, int reg, int data)
{
	//
	WriteIc(cs, addr+0, reg&0xff);
	WriteIc(cs, addr+2, (reg>>8)&0xff);
	WriteIc(cs, addr+1, data&0xff);
}

int SccTest(void)
{
	//
#if 0
	const int cs = 3, addr = 0<<3;
#else
	const int cs = 0, addr = 1<<3;
#endif
	const int lensin = sizeof(sccsin)/sizeof(sccsin[0]);
	const char *chstr[5] = { "cha", "chb", "chc", "chd", "che" };
	//
	int i, ch, freq, freq2, vol, vol2, keyon;
	struct PcKeySence key;

	//
	ch = 0;
	freq = 111;
	freq2 = 0;
	vol = 15;
	vol2 = 8;
	keyon = 0;
	while(1){
		//
		PcKeySence(&key);
		if(key.key_code==0x00 || key.key_down==0){
			//入力なし、キー押上
			continue;
		}

		//
		if(key.key_code==0x1b){	//esc
			if(key.ctrl_state&0x10){
				//shift+esc
				printf(".PcSync\n");
				PcFlush();
				while(1){
					if(PcSync("psl", NULL))
						PcReset();
				}
			}
			break;
		}

		//共通
		int binit = 0, bch = 0, bfreq = 0, bfreq2 = 0, bvol = 0, bvol2 = 0, btoggle = 0;
		switch(key.key_code){
			case 0x1b:	//esc
				if(key.ctrl_state&0x10){
					//shift+esc
					printf(".PcSync\n");
					PcFlush();
					while(1){
						if(PcSync("psl", NULL))
							PcReset();
					}
				}
				return 0;
			case 0x70:	//f1
				//※他アプリ起動用、使用できない
				break;

			case 0x09:	//tab
				bch = 1;
				break;
			case 0xc0:	//@
				binit = 1;
				break;

			case 0x20:	//space
				btoggle = 1;
				break;

			case 0x26:	//↑
				if(key.ctrl_state&0x10)
					bvol2 = +1;
				else
					bvol = +1;
				break;
			case 0x25:	//←
				if(key.ctrl_state&0x10)
					bfreq2 = -1;
				else
					bfreq = -1;
				break;
			case 0x28:	//↓
				if(key.ctrl_state&0x10)
					bvol2 = -1;
				else
					bvol = -1;
				break;
			case 0x27:	//→
				if(key.ctrl_state&0x10)
					bfreq2 = +1;
				else
					bfreq = +1;
				break;
		}

		//
		if(binit){
			printf(".init\n");
			ResetDevice();
			//
			WriteScc(cs, addr, 0x5000, 0x00);
			WriteScc(cs, addr, 0x7000, 0x00);
			WriteScc(cs, addr, 0x9000, 0x3f);
			WriteScc(cs, addr, 0xb000, 0x00);
#if 1
			//sin
			for(i=0; i<4*32; i++)
				WriteScc(cs, addr, 0x9800+i, sccsin[i%lensin]);
#endif
#if 0
			//saw
			unsigned char v = 0x00;
			for(i=0; i<4*32; i++){
				WriteScc(cs, addr, 0x9800+i, v);
				v -= 256/32;
			}
#endif
#if 0
			//square
			for(i=0; i<4*32; i++)
				WriteScc(cs, addr, 0x9800+i, (i&1)?0x80:0x7f);
#endif
			//
			keyon = 0;
		}

		//
		if(bch){
			ch = (ch+1)%5;
			printf(".%s\n", chstr[ch]);
		}
		//
		if(bfreq){
			bfreq += freq;
			if(bfreq<0)
				bfreq = 0;
			else
			if(bfreq>0xfff)
				bfreq = 0xfff;
			if(bfreq!=freq){
				freq = bfreq;
				printf(".freq=%d\n", freq);
				if(keyon){
					WriteScc(cs, addr, 0x9880+ch*2, freq&0xff);
					WriteScc(cs, addr, 0x9881+ch*2, (freq>>8)&0x0f);
				}
			}
		}
		//
		if(bfreq2){
			bfreq2 += freq2;
			if(bfreq2<0)
				bfreq2 = 0;
			else
			if(bfreq2>0xfff)
				bfreq2 = 0xfff;
			if(bfreq2!=freq2){
				freq2 = bfreq2;
				printf(".freq2=%d\n", freq2);
				if(keyon){
					switch(ch){
						case 3:	//chd
							i = 4;
							WriteScc(cs, addr, 0x9880+i*2, freq2&0xff);
							WriteScc(cs, addr, 0x9881+i*2, (freq2>>8)&0x0f);
							WriteScc(cs, addr, 0x988a+i, vol2);
							WriteScc(cs, addr, 0x988f, (1<<ch)|(1<<i));
							break;
						case 4:	//che
							i = 3;
							WriteScc(cs, addr, 0x9880+i*2, freq2&0xff);
							WriteScc(cs, addr, 0x9881+i*2, (freq2>>8)&0x0f);
							WriteScc(cs, addr, 0x988a+i, vol2);
							WriteScc(cs, addr, 0x988f, (1<<ch)|(1<<i));
							break;
					}
				}
			}
		}
		//
		if(bvol){
			bvol += vol;
			if(bvol<0)
				bvol = 0;
			else
			if(bvol>0xf)
				bvol = 0xf;
			if(bvol!=vol){
				vol = bvol;
				printf(".vol=%d\n", vol);
				if(keyon)
					WriteScc(cs, addr, 0x988a+ch, vol);
			}
		}
		//
		if(bvol2){
			bvol2 += vol2;
			if(bvol2<0)
				bvol2 = 0;
			else
			if(bvol2>0xf)
				bvol2 = 0xf;
			if(bvol2!=vol2){
				vol2 = bvol2;
				printf(".vol2=%d\n", vol2);
			}
		}
		//
		if(btoggle){
			keyon ^= 1;
			if(keyon){
				printf(".keyon(%s, freq=%d, vol=%d)\n", chstr[ch], freq, vol);
				WriteScc(cs, addr, 0x9880+ch*2, freq&0xff);
				WriteScc(cs, addr, 0x9881+ch*2, (freq>>8)&0x0f);
				WriteScc(cs, addr, 0x988a+ch, vol);
				WriteScc(cs, addr, 0x988f, 1<<ch);
			} else {
				printf(".keyoff\n");
				WriteScc(cs, addr, 0x988f, 0x00);
				for(i=0; i<5; i++){
					WriteScc(cs, addr, 0x988a+i, 0x00);
					int fr = 0x009;//0x000;//0xfff;
					WriteScc(cs, addr, 0x9880+i*2, fr&0xff);
					WriteScc(cs, addr, 0x9881+i*2, (fr>>8)&0x0f);
				}
			}
		}
	}

	return 0;
}
#endif

#if 0
void WriteOpxPcmd8Fpga(int cs, unsigned int addr, int reg, int data, int f)
{
	int addr2 = addr+((reg>>8)&0xf)*2;
	if(f)
		ChkStatusReg(cs, addr2, 0x80, 0x00);
	//
	WriteIc(cs, addr2, reg&0xff);
	WaitUs(2);
	WriteIc(cs, addr2+1, data&0xff);
	WaitUs(23);
}

/*
unsigned char ReadOpxPcmd8(int cs, unsigned int addr)
{
	//
	unsigned char data = ReadIc(cs, addr);
	return data;
}
*/

unsigned char ReadFpga(int cs, unsigned int addr, int reg, int f)
{
	int addr2 = addr+((reg>>8)&0xf)*2;
	if(f)
		ChkStatusReg(cs, addr2, 0x80, 0x00);
	//
	WriteIc(cs, addr2, reg&0xff);
	WaitUs(1);
	unsigned char data = ReadIc(cs, addr2+1);
	WaitUs(1);
	return data;
}

int OpxPcmd8Mem(void)
{
	//
	const int pcmlen = sizeof(pcm)/sizeof(pcm[0]);
	struct tagType {
		int cs, regoffs, memlim, chipnum;
		char *name;
	} const stype[] = {
		{ 2, 0x0900, ( 8*1024*1024)>>4, 271, "opx"   },
		{ 3, 0x0100, (16*1024*1024)>>4, 280, "pcmd8" },
	};
	const int OpxGroup2Addr[12] = {
		0x00, 0x01, 0x02, 0x04, 0x05, 0x06, 0x08, 0x09, 0x0a, 0x0c, 0x0d, 0x0e
	};
	const int OpxPan[16] = {
		0xff, 0xf0, 0x60, 0x50, 0x40, 0x30, 0x20, 0x10, (0x00), 0x01, 0x02, 0x03, 0x04, 0x05, 0x06, 0x0f
	};
	const int Pcmd8Pan[8] = { 3, 4, 6, 8, 12, 16, 24, 0 };
	//
	int i, j, type, mode, keyon, bit18, chmask, tl, pan;
	unsigned char data, data2, data3;
	struct PcKeySence key;

	//
	type = 1;
	mode = 0;
	keyon = 0;
	bit18 = 0;
	chmask = 0x000;
	tl = 31;
	pan = 8;
	while(1){
		//
		PcKeySence(&key);
		if(key.key_code==0x00 || key.key_down==0){
			//入力なし、キー押上
			continue;
		}

		//共通
		int btype = 0, binit = 0, bmode = 0, bmem = 0, bbit18 = 0, bchmask = 0, btl = 0, bpan = 0, btoggle = 0;
		switch(key.key_code){
			case 0x1b:	//esc
				if(key.ctrl_state&0x10){
					//shift+esc
					printf(".PcSync\n");
					PcFlush();
					while(1){
						if(PcSync("psl", NULL))
							PcReset();
					}
				}
				return 0;
			case 0x70:	//f1
				//※他アプリ起動用、使用できない
				break;

			case 0x31:	//1
			case 0x32:	//2
			case 0x33:	//3
			case 0x34:	//4
			case 0x35:	//5
			case 0x36:	//6
			case 0x37:	//7
			case 0x38:	//8
			case 0x39:	//9
				bchmask = key.key_code-0x30;
				break;

			case 0x41:	//a
			case 0x42:	//b
			case 0x43:	//c
				bchmask = key.key_code-0x41 + 10;
				break;

			case 0x08:	//backspace
				bbit18 = 1;
				break;

			case 0x09:	//tab
				bmode = 1;
				break;
			case 0xc0:	//@
				binit = 1;
				break;

			case 0xf0:	//capslock
				btype = 1;
				break;

			case 0x4d:	//m
				bmem = 1;
				break;

			case 0x20:	//space
				btoggle = 1;
				break;
			case 0x26:	//↑
				btl = (key.ctrl_state&0x10)?+16:+1;
				break;
			case 0x25:	//←
				bpan = -1;
				break;
			case 0x28:	//↓
				btl = (key.ctrl_state&0x10)?-16:-1;
				break;
			case 0x27:	//→
				bpan = +1;
				break;
		}

		//
		if(btype){
			i = sizeof(stype)/sizeof(stype[0]);
			type = (type+1)%i;
			printf(".type=%d,[%s]\n", type, stype[type].name);
		}
		int cs = stype[type].cs, regoffs = stype[type].regoffs;
		int chipnum = stype[type].chipnum, memlim = stype[type].memlim>>4;
		char *name = stype[type].name;

		//
		if(binit){
			printf(".init(%s)\n", name);
			ResetDevice();
			//
			int saddr = 0x000000;
			WriteOpxPcmd8Fpga(cs, 0, regoffs+0x03, (saddr>>16)&0xff, 1);
			WriteOpxPcmd8Fpga(cs, 0, regoffs+0x02, (saddr>>8)&0xff, 1);
			WriteOpxPcmd8Fpga(cs, 0, regoffs+0x18, saddr&0xff, 1);
			//
			int sample = 0;
			switch(chipnum){
				case 271:
					//
					WriteOpxPcmd8Fpga(cs, 0, regoffs+0x01, 0x10|(bit18<<2), 1);
					for(i=0; i<pcmlen*2; i+=4){
						j = i%pcmlen;
						short veven = pcm[j+1]|((short)pcm[j]<<8);
						j = (i+2)%pcmlen;
						short vodd = pcm[j+1]|((short)pcm[j]<<8);
						veven >>= 4;
						vodd >>= 4;
						data = (veven>>4)&0xff;
						data2 = ((vodd&0x0f)<<4)|(veven&0x0f);
						data3 = (vodd>>4)&0xff;
						WriteOpxPcmd8Fpga(cs, 0, regoffs+0x08, data, 1);
						WriteOpxPcmd8Fpga(cs, 0, regoffs+0x08, data2, 1);
						WriteOpxPcmd8Fpga(cs, 0, regoffs+0x08, data3, 1);
						sample += 2;
					}
					//
					for(i=0; i<3; i++){
						int gaddr = OpxGroup2Addr[i*4];
						WriteOpxPcmd8Fpga(cs, 0, 0x0600+gaddr, 0x03, 0);
						for(j=0; j<4; j++){
							int baddr = j*0x0100+gaddr;
							WriteOpxPcmd8Fpga(cs, 0, 0x0010+baddr, 0x00, 0);
							WriteOpxPcmd8Fpga(cs, 0, 0x0020+baddr, 0x00, 0);
							WriteOpxPcmd8Fpga(cs, 0, 0x0030+baddr, 0x01, 0);
							WriteOpxPcmd8Fpga(cs, 0, 0x0050+baddr, 0x1f, 0);
							WriteOpxPcmd8Fpga(cs, 0, 0x0060+baddr, 0x00, 0);
							WriteOpxPcmd8Fpga(cs, 0, 0x0070+baddr, 0x00, 0);
							WriteOpxPcmd8Fpga(cs, 0, 0x0080+baddr, 0x0f, 0);
							WriteOpxPcmd8Fpga(cs, 0, 0x00b0+baddr, 0x07, 0);
							WriteOpxPcmd8Fpga(cs, 0, 0x00c0+baddr, 0x00, 0);
							WriteOpxPcmd8Fpga(cs, 0, 0x00e0+baddr, 0x00, 0);
						}
					}
					//
					for(i=0; i<12; i++){
						int sladdr = OpxGroup2Addr[i];
						WriteOpxPcmd8Fpga(cs, 0, 0x0400+sladdr, saddr&0xff, 0);
						WriteOpxPcmd8Fpga(cs, 0, 0x0410+sladdr, (saddr>>8)&0xff, 0);
						WriteOpxPcmd8Fpga(cs, 0, 0x0420+sladdr, (saddr>>16)&0x7f, 0);
						WriteOpxPcmd8Fpga(cs, 0, 0x0430+sladdr, sample&0xff, 0);
						WriteOpxPcmd8Fpga(cs, 0, 0x0440+sladdr, (sample>>8)&0xff, 0);
						WriteOpxPcmd8Fpga(cs, 0, 0x0450+sladdr, (sample>>16)&0x7f, 0);
						j = 0;
						WriteOpxPcmd8Fpga(cs, 0, 0x0460+sladdr, j&0xff, 0);
						WriteOpxPcmd8Fpga(cs, 0, 0x0470+sladdr, (j>>8)&0xff, 0);
						WriteOpxPcmd8Fpga(cs, 0, 0x0480+sladdr, (j>>16)&0x7f, 0);
						WriteOpxPcmd8Fpga(cs, 0, 0x0490+sladdr, 0x04, 0);
					}
					break;
				case 280:
					//
					WriteOpxPcmd8Fpga(cs, 0, regoffs+0x01, 0x10, 1);
					for(i=0; i<pcmlen*2; i+=2){
						j = i%pcmlen;
						WriteOpxPcmd8Fpga(cs, 0, regoffs+0x08, pcm[j+1], 1);
						WriteOpxPcmd8Fpga(cs, 0, regoffs+0x08, pcm[j], 1);
						sample++;
					}
					int eaddr = saddr+(sample-1)*2;
					//
					WriteOpxPcmd8Fpga(cs, 0, 0x0081, 0x01, 0);
					WriteOpxPcmd8Fpga(cs, 0, 0x00ff, 0xd0, 0);
					WaitMs(1);
					//
					for(i=0; i<8; i++){
						WriteOpxPcmd8Fpga(cs, 0, 0x0020+i*4, (saddr>>16)&0xff, 0);
						WriteOpxPcmd8Fpga(cs, 0, 0x0021+i*4, (saddr>>16)&0xff, 0);
						WriteOpxPcmd8Fpga(cs, 0, 0x0022+i*4, (eaddr>>16)&0xff, 0);
						WriteOpxPcmd8Fpga(cs, 0, 0x0023+i*4, (eaddr>>16)&0xff, 0);
						WriteOpxPcmd8Fpga(cs, 0, 0x0040+i*4, (saddr>>8)&0xff, 0);
						WriteOpxPcmd8Fpga(cs, 0, 0x0041+i*4, (saddr>>8)&0xff, 0);
						WriteOpxPcmd8Fpga(cs, 0, 0x0042+i*4, (eaddr>>8)&0xff, 0);
						WriteOpxPcmd8Fpga(cs, 0, 0x0043+i*4, (eaddr>>8)&0xff, 0);
						WriteOpxPcmd8Fpga(cs, 0, 0x0060+i*4, saddr&0xff, 0);
						WriteOpxPcmd8Fpga(cs, 0, 0x0061+i*4, saddr&0xff, 0);
						WriteOpxPcmd8Fpga(cs, 0, 0x0062+i*4, eaddr&0xff, 0);
						WriteOpxPcmd8Fpga(cs, 0, 0x0063+i*4, eaddr&0xff, 0);
					}
					break;
			}
		}
		//
		if(bmode){
			mode ^= 1;
			printf(".mode=%d,%s\n", mode, mode?"square":"sin");
		}

		//
		if(bmem){
			printf(".memory_test_start\n");
			i = 0x000000;
			WriteOpxPcmd8Fpga(cs, 0, regoffs+0x03, (i>>16)&0xff, 1);
			WriteOpxPcmd8Fpga(cs, 0, regoffs+0x02, (i>>8)&0xff, 1);
			WriteOpxPcmd8Fpga(cs, 0, regoffs+0x18, i&0xff, 1);
			for(; i<memlim; i++){
				if((i&0x03ffff)==0)
					printf("$%06x=$00\n", i);
				WriteOpxPcmd8Fpga(cs, 0, regoffs+0x08, 0x00, 1);
			}
			//
			data = 0x00;
			int skip = 0;
			for(i=0x000000; i<memlim; i++){
				//
				if((i&0x03ffff)==0){
					printf("%s$%06x", i?"\n":"", i);
					skip = 0;
				}
				data = (data+3)&0xff;
				if(data==0)
					data++;
				if(skip==0){
					//
					WriteOpxPcmd8Fpga(cs, 0, regoffs+0x03, (i>>16)&0xff, 1);
					WriteOpxPcmd8Fpga(cs, 0, regoffs+0x02, (i>>8)&0xff, 1);
					WriteOpxPcmd8Fpga(cs, 0, regoffs+0x18, i&0xff, 1);
					data3 = ReadFpga(cs, 0, regoffs+0x18, 1);
					WriteOpxPcmd8Fpga(cs, 0, regoffs+0x08, data, 1);
					//
					WriteOpxPcmd8Fpga(cs, 0, regoffs+0x03, (i>>16)&0xff, 1);
					WriteOpxPcmd8Fpga(cs, 0, regoffs+0x02, (i>>8)&0xff, 1);
					WriteOpxPcmd8Fpga(cs, 0, regoffs+0x18, i&0xff, 1);
					data2 = ReadFpga(cs, 0, regoffs+0x18, 1);
					if(data3!=0x00 || data!=data2){
						printf(",$%06x:$00<>$%02x,$%02x<>$%02x", i, data3, data, data2);
						skip = 1;
					}
				}
			}
			printf("\n");
			//
			printf(".memory_test_end\n");
		}

		//
		if(chipnum==271 && bbit18){
			bit18 ^= 1;
			printf(".bit18=%d,%s\n", bit18, bit18?"18bit":"16bit");
		}
		//
		if(bchmask){
			chmask ^= 1<<(bchmask-1);
			printf(".chmask=%03x[", chmask);
			for(i=0; i<12; i++)
				printf("%c", (chmask&(1<<(11-i)))?'1':'0');
			printf("]\n");
		}
		//
		if(chipnum==280 && btl){
			btl += tl;
			if(btl<0)
				btl = 0;
			else
			if(btl>0xff)
				btl = 0xff;
			if(btl!=tl){
				tl = btl;
				printf(".tl=%d, ", tl);
				if(tl==0)
					printf("-inf");
				else
					printf("%5.2f", 20*log10(tl/255.0));
				printf("\n");
			}
			if(keyon){
				for(i=0; i<8; i++)
					WriteOpxPcmd8Fpga(cs, 0, 0x0002+i*4, tl, 0);
			}
		}
		//
		if(bpan){
			bpan += pan;
			if(bpan<0)
				bpan = 0;
			else
			if(bpan>0xf)
				bpan = 0xf;
			if(bpan!=pan){
				pan = bpan;
				int panl, panr;
				if(pan==0){
					panl = 7;
					panr = 7;
				} else {
					panl = (pan>=8)?0:(8-pan);
					panr = (pan<=8)?0:(pan-8);
				}
				printf(".pan=%d, %s=", pan, (chipnum==271)?"ch0":"l");
				if(panl==7)
					printf("-inf");
				else
					printf("%5.2f", 20*log10(3.0/Pcmd8Pan[panl]));
				printf(",%s=", (chipnum==271)?"ch1":"r");
				if(panr==7)
					printf("-inf");
				else
					printf("%5.2f", 20*log10(3.0/Pcmd8Pan[panr]));
				printf("\n");
			}
			if(keyon){
				switch(chipnum){
					case 271:
						for(i=0; i<12; i++){
							int baddr = (i/3)*0x0100+OpxGroup2Addr[(i%3)*4];
							WriteOpxPcmd8Fpga(cs, 0, 0x00d0+baddr, OpxPan[pan], 0);
						}
						break;
					case 280:
						for(i=0; i<8; i++)
							WriteOpxPcmd8Fpga(cs, 0, 0x0003+i*4, pan, 0);
						break;
				}
			}
		}
		//
		if(btoggle){
			keyon ^= 1;
			printf(".key%s\n", keyon?"on":"off");
			switch(chipnum){
				case 271:
					if(keyon){
						//keyon
						if(mode){
							//square
							const int tbl[12][2] = {
								{  0, 0x0000 },
								{ 13, 0x1400 },
								{ 19, 0x2200 },
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								{ 36, 0x4380 },	//※fs/2以上になる
							};
							for(i=0; i<12; i++){
								int baddr = (i/3)*0x0100+OpxGroup2Addr[(i%3)*4];
								WriteOpxPcmd8Fpga(cs, 0, 0x0040+baddr, chmask?0x00:tbl[i][0], 0);
								WriteOpxPcmd8Fpga(cs, 0, 0x00d0+baddr, OpxPan[pan], 0);
								j = tbl[chmask?0:i][1];
								WriteOpxPcmd8Fpga(cs, 0, 0x00a0+baddr, (j>>8)&0xff, 0);
								WriteOpxPcmd8Fpga(cs, 0, 0x0090+baddr, j&0xff, 0);
							}
							for(i=0; i<12; i++){
								if((1<<i)&(~chmask)){
									int baddr = (i/3)*0x0100+OpxGroup2Addr[(i%3)*4];
									WriteOpxPcmd8Fpga(cs, 0, 0x0000+baddr, 0x01, 0);
									WaitUs(10000-51);	//(441/44100)*1e6=10000
								}
							}
						} else {
							//sin
							i = 0;
							int baddr = (i/3)*0x0100+OpxGroup2Addr[(i%3)*4];
							WriteOpxPcmd8Fpga(cs, 0, 0x0040+baddr, 0x00, 0);
							WriteOpxPcmd8Fpga(cs, 0, 0x00d0+baddr, OpxPan[pan], 0);
							j = (0<<12)|0x000;
							WriteOpxPcmd8Fpga(cs, 0, 0x00a0+baddr, (j>>8)&0xff, 0);
							WriteOpxPcmd8Fpga(cs, 0, 0x0090+baddr, j&0xff, 0);
							WriteOpxPcmd8Fpga(cs, 0, 0x0000+baddr, 0x01, 0);
						}
					} else {
						//keyoff
						for(i=0; i<12; i++){
							int baddr = (i/3)*0x0100+OpxGroup2Addr[(i%3)*4];
							WriteOpxPcmd8Fpga(cs, 0, 0x0040+baddr, 0x7f, 0);
							WriteOpxPcmd8Fpga(cs, 0, 0x0000+baddr, 0x00, 0);
						}
					}
					break;
				case 280:
					if(keyon){
						//keyon
						int fn = 0x100-1;
						if(mode){
							//square
							for(i=0; i<8; i++){
								if((1<<i)&(~chmask)){
									WriteOpxPcmd8Fpga(cs, 0, 0x0002+i*4, tl, 0);
									WriteOpxPcmd8Fpga(cs, 0, 0x0003+i*4, pan, 0);
									WriteOpxPcmd8Fpga(cs, 0, 0x0000+i*4, fn&0xff, 0);
									WriteOpxPcmd8Fpga(cs, 0, 0x0001+i*4, 0xf0|((fn>>8)&1), 0);
								}
								fn += chmask?0x00:0x10;
							}
						} else {
							//sin
							i = 0;
							WriteOpxPcmd8Fpga(cs, 0, 0x0002+i*4, tl, 0);
							WriteOpxPcmd8Fpga(cs, 0, 0x0003+i*4, pan, 0);
							WriteOpxPcmd8Fpga(cs, 0, 0x0000+i*4, fn&0xff, 0);
							WriteOpxPcmd8Fpga(cs, 0, 0x0001+i*4, 0xf0|((fn>>8)&1), 0);
						}
					} else {
						//keyoff
						for(i=0; i<8; i++){
							WriteOpxPcmd8Fpga(cs, 0, 0x0002+i*4, 0, 0);
							WriteOpxPcmd8Fpga(cs, 0, 0x0001+i*4, 0x70, 0);
						}
					}
					break;
			}
		}
	}
}
#endif

#if 0
void Write2a03Fpga(int cs, unsigned int addr, int reg, int data)
{
	int offs = (reg>>8)&0xf;
	int addr2 = addr+offs*2;
	ChkStatusReg(cs, addr2, 0x80, 0x00);
	//
	WriteIc(cs, addr2, reg&0xff);
	switch(offs){
		case 2:
			WaitUs(11);
			WriteIc(cs, addr2+1, data&0xff);
			WaitUs(24);
			break;
		default:
			WriteIc(cs, addr2+1, data&0xff);
			break;
	}
}

unsigned char Read2a03Fpga(int cs, unsigned int addr, int reg)
{
	int offs = (reg>>8)&0xf;
	int addr2 = addr+offs*2;
	ChkStatusReg(cs, addr2, 0x80, 0x00);
	//
	WriteIc(cs, addr2, reg&0xff);
	return ReadIc(cs, addr2+1);
}

int Rp2a03Test(void)
{
	//
	const int cs = 3, addr = 0;
	const int memlim = 1024*1024+4096;
	//
	int i, j, k, cpuregread, cpunc, keyon;
	unsigned char data, data2, data3;
	struct PcKeySence key;

	//
	cpuregread = 0;
	cpunc = 0;
	keyon = 0;
	while(1){
		//
		PcKeySence(&key);
		if(key.key_code==0x00 || key.key_down==0){
			//入力なし、キー押上
			continue;
		}

		//共通
		int binit = 0, bmem = 0, bcpuregread = 0, bcpunc = 0, bcpuregtest = 0, bextchiptest = 0, btoggle = 0;
		switch(key.key_code){
			case 0x1b:	//esc
				if(key.ctrl_state&0x10){
					//shift+esc
					printf(".PcSync\n");
					PcFlush();
					while(1){
						if(PcSync("psl", NULL))
							PcReset();
					}
				}
				return 0;
			case 0x70:	//f1
				//※他アプリ起動用、使用できない
				break;

			case 0x09:	//tab
				bcpunc = 1;
				break;
			case 0x45:	//e
				bextchiptest = 1;
				break;
			case 0x52:	//r
				bcpuregtest = 1;
				break;
			case 0xc0:	//@
				binit = 1;
				break;

			case 0xf0:	//capslock
				bcpuregread = 1;
				break;

			case 0x4d:	//m
				bmem = 1;
				break;

			case 0x20:	//space
				btoggle = 1;
				break;
		}

		//
		if(binit){
			printf(".init\n");
			ResetDevice();
			//
			Write2a03Fpga(cs, addr, 0x301, (cpuregread?0x80:0)|(cpunc?0x08:0)|0x03);
			//
			i = 0x103ffa;
			Write2a03Fpga(cs, addr, 0x303, (i>>16)&0x1f);
			Write2a03Fpga(cs, addr, 0x302, (i>>8)&0xff);
			Write2a03Fpga(cs, addr, 0x318, i&0xff);
			i = 0x3900;
			Write2a03Fpga(cs, addr, 0x308, i&0xff);
			Write2a03Fpga(cs, addr, 0x308, (i>>8)&0xff);
			Write2a03Fpga(cs, addr, 0x308, i&0xff);
			Write2a03Fpga(cs, addr, 0x308, (i>>8)&0xff);
			Write2a03Fpga(cs, addr, 0x308, i&0xff);
			Write2a03Fpga(cs, addr, 0x308, (i>>8)&0xff);
			//
			i = 0x103900;
			Write2a03Fpga(cs, addr, 0x303, (i>>16)&0x1f);
			Write2a03Fpga(cs, addr, 0x302, (i>>8)&0xff);
			Write2a03Fpga(cs, addr, 0x318, i&0xff);
			if(0){
				const unsigned char bin[] = {
#if 0
					//発音確認
					0xa9,0x00,0x8d,0x17,0x40,0xa9,0x0f,0x8d,0x15,0x40,
					0xa9,0xbf,0x8d,0x00,0x40,0xa9,0x6f,0x8d,0x02,0x40,0xa9,0x00,0x8d,0x03,0x40,
					0x38,0xb0,0xfe,
#endif
#if 1
					//$4000～$401f読み書き
					0x78,0xd8,0xa9,0x00,0x8d,0x00,0x20,0xa2,0xff,0x9a,0xa2,0x00,0xa0,0xff,0xa9,0x00,
					0x94,0x40,0x95,0x60,0xe8,0xe0,0x20,0xd0,0xf7,0xa0,0x00,0xa2,0x00,
#if 0
					//$00-$13, $15-$1f
					0xe0,0x14,0xf0,0x12,
#else
					//$00-$1f
					0xea,0xea,0xea,0xea,
#endif
					0x98,0x9d,0x00,0x40,0xea,0xbd,0x00,0x40,0x48,0x35,0x40,0x95,0x40,0x68,0x15,
					0x60,0x95,0x60,0xe8,0xe0,0x20,0xd0,0xe5,0xc8,0x90,0xe0,0xb0,0xde,0xff,0xff,0xff,
#endif
				};
				const int binlen = sizeof(bin)/sizeof(bin[0]);
				for(i=0; i<binlen; i++)
					Write2a03Fpga(cs, addr, 0x308, bin[i]);
				//
				Write2a03Fpga(cs, addr, 0x301, (cpuregread?0x80:0)|(cpunc?0x08:0)|0x00);
			}
		}

		//
		if(bmem){
			printf(".memory_test_start\n");
			//
			Write2a03Fpga(cs, addr, 0x301, 0x03);
			//
			i = 0x000000;
			Write2a03Fpga(cs, addr, 0x303, (i>>16)&0x1f);
			Write2a03Fpga(cs, addr, 0x302, (i>>8)&0xff);
			Write2a03Fpga(cs, addr, 0x318, i&0xff);
			for(; i<memlim; i++){
				if((i&0x01ffff)==0)
					printf("$%06x=$00\n", i);
				Write2a03Fpga(cs, addr, 0x308, 0x00);
			}
			//
			data = 0x00;
			int skip = 0;
			for(i=0x000000; i<memlim; i++){
				//
				if((i&0x01ffff)==0){
					printf("$%06x\n", i);
					skip = 0;
				}
				data = (data+3)&0xff;
				if(data==0)
					data++;
				if(skip<5){
					//
					Write2a03Fpga(cs, addr, 0x303, (i>>16)&0x1f);
					Write2a03Fpga(cs, addr, 0x302, (i>>8)&0xff);
					Write2a03Fpga(cs, addr, 0x318, i&0xff);
					data3 = Read2a03Fpga(cs, addr, 0x318);
					Write2a03Fpga(cs, addr, 0x308, data);
					//
					Write2a03Fpga(cs, addr, 0x303, (i>>16)&0x1f);
					Write2a03Fpga(cs, addr, 0x302, (i>>8)&0xff);
					Write2a03Fpga(cs, addr, 0x318, i&0xff);
					data2 = Read2a03Fpga(cs, addr, 0x318);
					if(data3!=0x00 || data!=data2){
						printf("$%06x:$00<>$%02x,$%02x<>$%02x\n", i, data3, data, data2);
						skip++;
					}
				}
			}
			//
			printf(".memory_test_end\n");
		}

		//
		if(bcpuregread){
			cpuregread ^= 1;
			printf(".cpuregread=%d\n", cpuregread);
		}
		//
		if(bcpunc){
			cpunc ^= 1;
			printf(".cpunc=%d\n", cpunc);
		}
		//
		if(bcpuregtest){
			printf(".cpuregtest\n");
			//
			int raddr = 0x100040;
			printf(".and=");
			for(i=0; i<0x20; i++){
				if(i && (i&0x7)==0)
					printf(",");
				Write2a03Fpga(cs, addr, 0x303, (raddr>>16)&0x1f);
				Write2a03Fpga(cs, addr, 0x302, (raddr>>8)&0xff);
				Write2a03Fpga(cs, addr, 0x318, raddr&0xff);
				raddr++;
				printf("%02x", Read2a03Fpga(cs, addr, 0x318));
			}
			printf("\n");
			printf(".or =");
			for(i=0; i<0x20; i++){
				if(i && (i&0x7)==0)
					printf(",");
				Write2a03Fpga(cs, addr, 0x303, (raddr>>16)&0x1f);
				Write2a03Fpga(cs, addr, 0x302, (raddr>>8)&0xff);
				Write2a03Fpga(cs, addr, 0x318, raddr&0xff);
				raddr++;
				printf("%02x", Read2a03Fpga(cs, addr, 0x318));
			}
			printf("\n");
/*
	BNC <= '0'
	attribute KEEPER of BD: signal is "TRUE";
	.and=4040404040404040,4040404040404040,40404040ff004040,4040404040404040
	.or =4040404040404040,4040404040404040,40404040001e4040,4040404040404040
	attribute PULLUP of BD: signal is "TRUE";
	.and=ffffffffffffffff,ffffffffffffffff,ffffffffff00ffff,ffffffffffffffff
	.or =ffffffffffffffff,ffffffffffffffff,ffffffff001effff,ffffffffffffffff
	.and=ffffffffffffffff,ffffffffffffffff,ffffffffff00ffff,ffffffffffffffff	//$00-$1f
	.or =ffffffffffffffff,ffffffffffffffff,ffffffffff1effff,ffffffffffffffff	//$00-$1f

	BNC <= '1';
	attribute KEEPER of BD: signal is "TRUE";
	.and=4040404040404040,4040404040404040,40404040ff004040,0000004040404040
	.or =4040404040404040,4040404040404040,40404040001e4040,ffff7f4040404040
	attribute PULLUP of BD: signal is "TRUE";
	.and=4040404040404040,4040404040404040,40404040ff004040,0000004040404040
	.or =4040404040404040,4040404040404040,40404040001e4040,ffff7f4040404040
	.and=4040404040404040,4040404040404040,4040404040004040,0000004040404040	//$00-$1f
	.or =4040404040404040,4040404040404040,40404040401e4940,ffff7f4040404040	//$00-$1f
*/
		}

		//
		if(bextchiptest){
			printf(".extchiptest\n");
			//
			s32 fh = PcOpen(".\\_extchip_@3.bin", PC_WRONLY|PC_BINARY|PC_CREAT);
			if(fh==-1){
				printf(".PcOpen\n");
			} else {
				//
				const int ers = 2;
				Write2a03Fpga(cs, addr, 0x384, (1<<ers)&7);
				unsigned char wbuf[0x20][2];
				memset(wbuf, 0xaa, sizeof(wbuf));
				for(i=0x4020; i<0x10000; ){
					if((i&0x07ff)==0)
						printf("$%04x\n", i);
					Write2a03Fpga(cs, addr, 0x383, (i>>8)&0xff);
					for(k=(i&0x1f); k<0x20; k++){
						wbuf[k][0] = 0xff;	//and
						wbuf[k][1] = 0x00;	//or
						for(j=0; j<256; j++){
							//write
							Write2a03Fpga(cs, addr, 0x382, i&0xff);
							Write2a03Fpga(cs, addr, 0x388, j&0xff);
							WaitUs(4);	//vrc7用（アドレス書き込み後のウェイト）
							//read
							Write2a03Fpga(cs, addr, 0x398, i&0xff);
							data = Read2a03Fpga(cs, addr, 0x398);
							wbuf[k][0] &= data;
							wbuf[k][1] |= data;
						}
						i++;
					}
					PcWrite(fh, wbuf, sizeof(wbuf));
				}
				PcClose(fh);
			}
		}

		//
		if(btoggle){
			keyon ^= 1;
			printf(".key%s\n", keyon?"on":"off");
			if(keyon){
			} else {
			}
		}
	}
}
#endif
#endif
